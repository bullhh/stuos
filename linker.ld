/* 
 * StuOS 链接脚本
 * 用于定义操作系统内核在内存中的布局
 * 
 * 该脚本定义了内核各个段在内存中的位置和对齐要求，
 * 确保内核能够正确加载和运行。
 */

/* 指定目标架构为ARM */
OUTPUT_ARCH("aarch64")

/* 定义内核的入口点函数 */
ENTRY(_start_asm)

/* 定义内核加载的基地址 */
BASE_ADDRESS = 0x40200000;

SECTIONS
{
    /* 设置当前位置为基地址 */
    . = BASE_ADDRESS;
    
    /* 内核起始地址符号 */
    skernel = .;

    /* 内核代码段起始地址符号 */
    stext = .;
    
    /* 代码段：包含所有可执行代码 */
    .text : {
        /* 入口点代码段 */
        *(.text.entry)
        /* 所有其他代码段 */
        *(.text .text.*)
    }
    
    /* 4KB对齐 */
    . = ALIGN(4K);
    
    /* 内核代码段结束地址符号 */
    etext = .;
    
    /* 只读数据段起始地址符号 */
    srodata = .;
    
    /* 只读数据段：包含常量数据 */
    .rodata : {
        /* 只读数据 */
        *(.rodata .rodata.*)
        /* 小的只读数据 */
        *(.srodata .srodata.*)
    }
    
    /* 4KB对齐 */
    . = ALIGN(4K);
    
    /* 只读数据段结束地址符号 */
    erodata = .;
    
    /* 可读写数据段起始地址符号 */
    sdata = .;
    
    /* 可读写数据段：包含初始化的可变数据 */
    .data : {
        /* 可读写数据 */
        *(.data .data.*)
        /* 小的可读写数据 */
        *(.sdata .sdata.*)
    }
    
    /* 4KB对齐 */
    . = ALIGN(4K);
    
    /* 可读写数据段结束地址符号 */
    edata = .;
    
    /* 未初始化数据段：包含未初始化的可变数据 */
    .bss : {
        /* 栈空间 */
        *(.bss.stack)
        /* 未初始化数据段起始地址符号 */
        sbss = .;
        /* 未初始化数据 */
        *(.bss .bss.*)
        /* 小的未初始化数据 */
        *(.sbss .sbss.*)
    }
    
    /* 4KB对齐 */
    . = ALIGN(4K);
    
    /* 未初始化数据段结束地址符号 */
    ebss = .;
    
    /* 内核结束地址符号 */
    ekernel = .;
    
    /* 栈顶指针定义 */
    stack_top = .;

    /* 丢弃不需要的段 */
    /DISCARD/ : {
        /* 异常帧信息 */
        *(.eh_frame)
    }
}